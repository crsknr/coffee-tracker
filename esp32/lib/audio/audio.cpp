#include "audio.h"
#include "config.h"
#include <Arduino.h>
#include <math.h>

#if ENABLE_AUDIO_WAKE
#include <driver/i2s.h>
#include <SD.h>
#endif

// ============================================
// Reference snippet generated by audio/extract_reference.py
// from test_audio/grinder.wav (48 kHz → 16 kHz, middle 64 samples, L2-normalised)
// Used as flash fallback when /grinder_ref.bin is not on the SD card.
// ============================================

static const float grinder_ref_default[XCORR_FRAME_SIZE] = {
    -0.01918294f, -0.10101332f, -0.09124672f, -0.01184317f, -0.04387474f, -0.07144777f, +0.07222887f, +0.17678431f,
    +0.13505575f, +0.02141814f, -0.08782097f, -0.14239889f, -0.20122121f, -0.12209387f, +0.00490096f, -0.01955246f,
    +0.03026481f, +0.13987030f, +0.06076781f, -0.03940360f, +0.00515159f, +0.05965135f, +0.12598565f, +0.20980892f,
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    -0.15733775f, -0.25385857f, -0.22551492f, +0.01093643f, +0.02974116f, -0.03426968f, +0.07041875f, +0.13825803f,
};

// ============================================
// Static state
// ============================================

static float    reference[XCORR_FRAME_SIZE];
static float    smoothedEnergy  = 0.0f;
static int      sustainedFrames = 0;

// ============================================
// Internal helpers
// ============================================

// L2-normalise src into dst in-place (length N).
// Returns false if the signal is silent (norm ≈ 0).
static bool l2Normalise(float *dst, const float *src, int n) {
    float sumSq = 0.0f;
    for (int i = 0; i < n; i++) sumSq += src[i] * src[i];
    float norm = sqrtf(sumSq);
    if (norm < 1e-9f) return false;
    float inv = 1.0f / norm;
    for (int i = 0; i < n; i++) dst[i] = src[i] * inv;
    return true;
}

// Maximum absolute cross-correlation between two unit-normalised vectors
// (mode='same': lags from -(N/2) to +(N/2-1), output length N).
static float xcorrMax(const float *frame, const float *ref, int n) {
    float best = 0.0f;
    int half = n / 2;
    for (int lag = -half; lag < half; lag++) {
        float sum = 0.0f;
        for (int i = 0; i < n; i++) {
            int j = i - lag;
            if (j >= 0 && j < n) sum += frame[i] * ref[j];
        }
        float absSum = fabsf(sum);
        if (absSum > best) best = absSum;
    }
    return best;
}

// ============================================
// Load reference from SD or fall back to flash
// ============================================

static void loadReference() {
#if ENABLE_AUDIO_WAKE
    File f = SD.open(GRINDER_REF_PATH, FILE_READ);
    if (f && f.size() == XCORR_FRAME_SIZE * sizeof(float)) {
        f.read((uint8_t *)reference, XCORR_FRAME_SIZE * sizeof(float));
        f.close();
        Serial.println("[AUDIO] Reference loaded from SD " GRINDER_REF_PATH);
        return;
    }
    if (f) f.close();
    Serial.println("[AUDIO] " GRINDER_REF_PATH " not found, using flash fallback");
#endif
    memcpy(reference, grinder_ref_default, sizeof(reference));
}

// ============================================
// Start I2S microphone
// ============================================

void startAudio() {
#if ENABLE_AUDIO_WAKE
    i2s_config_t i2s_config = {};
    i2s_config.mode                 = (i2s_mode_t)(I2S_MODE_MASTER | I2S_MODE_RX);
    i2s_config.sample_rate          = I2S_SAMPLE_RATE;
    i2s_config.bits_per_sample      = I2S_BITS_PER_SAMPLE_16BIT;
    i2s_config.channel_format       = I2S_CHANNEL_FMT_ONLY_LEFT;
    i2s_config.communication_format = I2S_COMM_FORMAT_STAND_I2S;
    i2s_config.intr_alloc_flags     = ESP_INTR_FLAG_LEVEL1;
    i2s_config.dma_buf_count        = 4;
    i2s_config.dma_buf_len          = XCORR_FRAME_SIZE * 4;  // 4 frames per DMA buf
    i2s_config.use_apll             = false;

    i2s_pin_config_t pin_config = {};
    pin_config.bck_io_num    = I2S_SCK_PIN;
    pin_config.ws_io_num     = I2S_WS_PIN;
    pin_config.data_out_num  = I2S_PIN_NO_CHANGE;
    pin_config.data_in_num   = I2S_SD_PIN;

    i2s_driver_install(I2S_NUM_0, &i2s_config, 0, NULL);
    i2s_set_pin(I2S_NUM_0, &pin_config);

    loadReference();
    smoothedEnergy  = 0.0f;
    sustainedFrames = 0;

    Serial.println("[AUDIO] I2S started (xcorr detector, frame=" +
                   String(XCORR_FRAME_SIZE) + " samples, threshold=" +
                   String(XCORR_THRESHOLD) + ")");
#endif
}

// ============================================
// Stop I2S microphone
// ============================================

void stopAudio() {
#if ENABLE_AUDIO_WAKE
    i2s_driver_uninstall(I2S_NUM_0);
    smoothedEnergy  = 0.0f;
    sustainedFrames = 0;
    Serial.println("[AUDIO] I2S stopped");
#endif
}

// ============================================
// Process one I2S buffer, return true if grinder
// has been detected for >= GRINDER_SUSTAINED_MS
// ============================================

bool processAudioFrame() {
#if ENABLE_AUDIO_WAKE
    // Read one DMA buffer (XCORR_FRAME_SIZE * 4 samples)
    const int bufLen = XCORR_FRAME_SIZE * 4;
    int16_t raw[bufLen];
    size_t bytesRead = 0;

    esp_err_t err = i2s_read(I2S_NUM_0, raw, sizeof(raw), &bytesRead, 100);
    if (err != ESP_OK || bytesRead == 0) return false;

    int totalSamples = bytesRead / sizeof(int16_t);
    int numFrames    = totalSamples / XCORR_FRAME_SIZE;

    const float alpha = 1.0f / XCORR_SMOOTH_WINDOW;
    // Duration of each XCORR_FRAME_SIZE chunk in ms
    const float frameDurationMs = 1000.0f * XCORR_FRAME_SIZE / I2S_SAMPLE_RATE;

    for (int fi = 0; fi < numFrames; fi++) {
        // Convert int16 → float32
        float frameF[XCORR_FRAME_SIZE];
        for (int i = 0; i < XCORR_FRAME_SIZE; i++) {
            frameF[i] = raw[fi * XCORR_FRAME_SIZE + i] / 32768.0f;
        }

        // L2-normalise frame; skip silent frames (reset EMA gently)
        float frameN[XCORR_FRAME_SIZE];
        if (!l2Normalise(frameN, frameF, XCORR_FRAME_SIZE)) {
            smoothedEnergy  = alpha * 0.0f + (1.0f - alpha) * smoothedEnergy;
            sustainedFrames = 0;
            continue;
        }

        // Cross-correlate with reference, take max |xcorr|
        float rawEnergy = xcorrMax(frameN, reference, XCORR_FRAME_SIZE);

        // Exponential moving average
        smoothedEnergy = alpha * rawEnergy + (1.0f - alpha) * smoothedEnergy;

        if (smoothedEnergy > XCORR_THRESHOLD) {
            sustainedFrames++;
            float sustainedMs = sustainedFrames * frameDurationMs;
            Serial.printf("[AUDIO] energy=%.3f sustained=%.0fms\n",
                          smoothedEnergy, sustainedMs);
            if (sustainedMs >= GRINDER_SUSTAINED_MS) {
                return true;
            }
        } else {
            sustainedFrames = 0;
        }
    }
#endif
    return false;
}

// ============================================
// Record a reference snippet from the mic and
// save it to SD as GRINDER_REF_PATH.
// Trigger via serial: send "RECORD_REF" while awake.
// ============================================

void recordReference() {
#if ENABLE_AUDIO_WAKE
    Serial.println("[AUDIO] Recording reference — run the grinder now...");

    // Start I2S (re-entrant: safe to call if already started from sleep)
    bool wasRunning = false;
    // We always init fresh here; caller must ensure audio is not active
    i2s_config_t i2s_config = {};
    i2s_config.mode                 = (i2s_mode_t)(I2S_MODE_MASTER | I2S_MODE_RX);
    i2s_config.sample_rate          = I2S_SAMPLE_RATE;
    i2s_config.bits_per_sample      = I2S_BITS_PER_SAMPLE_16BIT;
    i2s_config.channel_format       = I2S_CHANNEL_FMT_ONLY_LEFT;
    i2s_config.communication_format = I2S_COMM_FORMAT_STAND_I2S;
    i2s_config.intr_alloc_flags     = ESP_INTR_FLAG_LEVEL1;
    i2s_config.dma_buf_count        = 4;
    i2s_config.dma_buf_len          = XCORR_FRAME_SIZE * 4;
    i2s_config.use_apll             = false;

    i2s_pin_config_t pin_config = {};
    pin_config.bck_io_num    = I2S_SCK_PIN;
    pin_config.ws_io_num     = I2S_WS_PIN;
    pin_config.data_out_num  = I2S_PIN_NO_CHANGE;
    pin_config.data_in_num   = I2S_SD_PIN;

    i2s_driver_install(I2S_NUM_0, &i2s_config, 0, NULL);
    i2s_set_pin(I2S_NUM_0, &pin_config);

    // Collect RECORD_DURATION_MS of audio into a heap buffer
    const int totalSamples = (int)(I2S_SAMPLE_RATE * RECORD_DURATION_MS / 1000.0f);
    int16_t *buf = (int16_t *)malloc(totalSamples * sizeof(int16_t));
    if (!buf) {
        Serial.println("[AUDIO] Out of memory for recording buffer");
        i2s_driver_uninstall(I2S_NUM_0);
        return;
    }

    int collected = 0;
    unsigned long deadline = millis() + RECORD_DURATION_MS + 500;
    while (collected < totalSamples && millis() < deadline) {
        const int chunk = XCORR_FRAME_SIZE * 4;
        int16_t tmp[chunk];
        size_t bytesRead = 0;
        if (i2s_read(I2S_NUM_0, tmp, chunk * sizeof(int16_t),
                     &bytesRead, 200) == ESP_OK && bytesRead > 0) {
            int n = min((int)(bytesRead / sizeof(int16_t)), totalSamples - collected);
            memcpy(buf + collected, tmp, n * sizeof(int16_t));
            collected += n;
        }
    }

    i2s_driver_uninstall(I2S_NUM_0);
    Serial.printf("[AUDIO] Captured %d samples\n", collected);

    if (collected < XCORR_FRAME_SIZE) {
        Serial.println("[AUDIO] Not enough samples captured");
        free(buf);
        return;
    }

    // Extract middle XCORR_FRAME_SIZE samples, convert to float32, L2-normalise
    int mid   = collected / 2;
    int start = mid - XCORR_FRAME_SIZE / 2;
    float ref[XCORR_FRAME_SIZE];
    for (int i = 0; i < XCORR_FRAME_SIZE; i++) {
        ref[i] = buf[start + i] / 32768.0f;
    }
    free(buf);

    if (!l2Normalise(ref, ref, XCORR_FRAME_SIZE)) {
        Serial.println("[AUDIO] Recorded signal is silent — aborting");
        return;
    }

    // Write to SD
    SD.remove(GRINDER_REF_PATH);
    File f = SD.open(GRINDER_REF_PATH, FILE_WRITE);
    if (!f) {
        Serial.println("[AUDIO] Failed to open " GRINDER_REF_PATH " for writing");
        return;
    }
    f.write((uint8_t *)ref, XCORR_FRAME_SIZE * sizeof(float));
    f.close();
    Serial.println("[AUDIO] Reference saved to " GRINDER_REF_PATH);

    // Reload into the active reference buffer
    memcpy(reference, ref, sizeof(reference));
#else
    Serial.println("[AUDIO] ENABLE_AUDIO_WAKE is false — nothing to record");
#endif
}
